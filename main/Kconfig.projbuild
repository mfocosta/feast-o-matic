## main/Kconfig.projbuild
```kconfig
menu "Feast-O-Matic Configuration"

    config WIFI_SSID
        string "SoftAP SSID"
        default "feastomatic"
        help
            SSID (network name) to set up the softAP with.

    config WIFI_PASSWORD
        string "SoftAP Password"
        default "feastomatic"
        help
            WiFi password (WPA or WPA2) for the example to use for the softAP.

    config WIFI_MAX_STA_CONN
        int "Maximum STA connections"
        default 1
        help
            Max number of the STA connects to AP.

    config FIRMWARE_UPGRADE_URL
        string "firmware upgrade url endpoint"
        default "https://github.com/mfocosta/feast-o-matic/releases/latest/download/feast-o-matic.bin"
        help
            URL of server which hosts the firmware
            image.

    config MQTT_BROKER_URL
        string "Default MQTT broker URL"
        default "mqtt://192.168.1.156:1883"
        help
            Default MQTT broker URL used on first boot.
            Can be overridden via the captive portal or updated at runtime.

    config 28BYJ48_STEPS_PER_REV
        int "28BYJ48 Steps Per Revolution"
        default 2048
        help
            Number of steps per revolution for the 28BYJ48 stepper motor.

    config HX711_CALIBRATION_FACTOR
        int "HX711 Calibration Factor"
        default -1057
        help
            Calibration factor for the HX711 load cell amplifier.

    config HX711_RAW_OFFSET
        int "HX711 Raw Offset (empty scale)"
        default 0
        help
            Raw HX711 reading with nothing on the scale and no bowl.
            Used instead of a live tare so the scale is zeroed without
            needing a known-empty pan at boot.

    config BOWL_WEIGHT_GRAMS
        int "Bowl weight in grams"
        default 0
        help
            Weight of the bowl in grams. Used to compensate the scale
            reading when a bowl is present but its NFC tag cannot be read.

    config SCHED_MAX
        int "Maximum number of schedules"
        default 4
        help
            Maximum number of schedules that can be configured.

    config TOF_FULL_MM
        int "ToF distance when reservoir is full (mm)"
        default 0
        help
            Distance reading (mm) from the VL53L1X sensor with the lid closed
            and the reservoir completely full. Measure on real hardware.

    config TOF_EMPTY_MM
        int "ToF distance when reservoir is empty (mm)"
        default 100
        help
            Distance reading (mm) from the VL53L1X sensor with the lid closed
            and the reservoir completely empty. Measure on real hardware.

    config MIN_FEED_INTERVAL_MIN
        int "Minimum interval between feed events (minutes)"
        default 5
        help
            Minimum time that must elapse between two consecutive feed events.
            Prevents MQTT command flooding from dispensing food continuously.
            Set to 0 to disable the guard.

    config LONG_PRESS_MS
        int "Long press duration (ms)"
        default 1000
        help
            Duration (in milliseconds) that a button must be pressed to be considered a long press.
            type unsigned

    config DEBOUNCE_MS
        int "Debounce duration (ms)"
        default 50
        help
            Duration (in milliseconds) that a button must be pressed to be considered as a valid press.
            type unsigned            

endmenu
```
